## arch/riscv/cpu/d1/Kconfig
```kconfig
# SPDX-License-Identifier: GPL-2.0+

config ALLWINNER_D1
	bool
	select SYS_CACHE_SHIFT_6
	select SUPPORT_SPL
	select BINMAN if SPL
	select SYS_CACHE_THEAD_CMO
	select CLK_THEAD
	imply CPU
	imply CPU_RISCV
	imply RISCV_TIMER if (RISCV_SMODE || SPL_RISCV_SMODE)
	imply CMD_CPU
	imply SPL_CPU
	imply SPL_OPENSBI
	imply SPL_LOAD_FIT
```

## arch/riscv/cpu/thead/Kconfig
```kconfig
# SPDX-License-Identifier: GPL-2.0+

config THEAD_C906
	bool
	select SYS_CACHE_SHIFT_6
	select SYS_CACHE_THEAD_CMO

config THEAD_E906
	bool
	select SYS_CACHE_SHIFT_5
	select SYS_CACHE_THEAD_CMO
```

## board/sun20i/Kconfig
```kconfig
if TARGET_SUN20I_D1

config SYS_BOARD
	default "sun20i"

config SYS_CPU
	default "thead"

config SYS_SOC
	default "sun20i-d1"

config SYS_CONFIG_NAME
	default "sun20i"

config IDENT_STRING
	default " Allwinner D1"

config SYS_CLK_FREQ
	default 1008000000

config SYS_LOAD_ADDR
	default 0x42000000

config TEXT_BASE
	default 0x42e00000

config HAS_CUSTOM_SYS_INIT_SP_ADDR
	default y

config CUSTOM_SYS_INIT_SP_ADDR
	default 0x43e00000

config SUNXI_SRAM_ADDRESS
	hex
	default 0x20000

config SUNXI_GEN_NCAT2
	bool
	select MMC_SUNXI_HAS_NEW_MODE
	select SUPPORT_SPL
	help
	  Select this for sunxi SoCs which have D1 like peripherals, clocks
	  and memory map.

config SUNXI_MINIMUM_DRAM_MB
	int
	default 64
	help
	  Minimum DRAM size expected on the board.

config DRAM_CLK
	default 792

config DRAM_ZQ
	default 8092667

config PRE_CON_BUF_ADDR
	default 0x43000000

config MISC_INIT_R
	default y

config SPL_MAX_SIZE
	default 0x27fa0

config SPL_PAD_TO
	default 0x0

config SPL_BSS_START_ADDR
	default 0x43f80000

config SPL_TEXT_BASE
	default 0x20060

config SPL_SHARES_INIT_SP_ADDR
	default n

config SPL_HAVE_INIT_STACK
	default y

config SPL_STACK
	default 0x48000

config SPL_STACK_R_ADDR
	default 0x43e00000

config SPL_OPENSBI_LOAD_ADDR
	default 0x40000000

config SYS_MMCSD_RAW_MODE_U_BOOT_SECTOR
	default 0x40

config SPL_SYS_MMCSD_RAW_MODE
	default y

config SYS_MMCSD_RAW_MODE_U_BOOT_DATA_PART_OFFSET
	default 0x10

config SYS_SPI_U_BOOT_OFFS
	default 0x8000

config MMC_SUNXI_SLOT_EXTRA
	int "mmc extra slot number"
	default -1
	help
	  D1 builds always enable mmc0. Some boards also have a second SD card
	  slot or eMMC on mmc1 - mmc3. Setting this to 1, 2, or 3 enables
	  support for this.

config SPL_IMAGE_TYPE
	string
	default "sunxi_egon"

config BOARD_SPECIFIC_OPTIONS
	def_bool y
	select BINMAN
	select CLK
	select CMD_GPIO if GPIO
	select CMD_MMC if MMC
	select CMD_USB if DISTRO_DEFAULTS && USB_HOST
	select DM
	select DM_GPIO if GPIO
	select DM_I2C if I2C
	select DM_MMC if MMC
	select DM_SERIAL if SERIAL
	select DM_SPI if SPI
	select DM_SPI_FLASH if SPI && MTD
	select ENV_RELOC_GD_ENV_ADDR
	select OF_BOARD_SETUP
	select OF_UPSTREAM
	select PINCTRL
	select RAM if SPL_DM
	select SPL_CLK if SPL_DM
	select SPL_DM if SPL
	select SPL_DM_SPI if SPL_DM && SPL_SPI
	select SPL_DM_SPI_FLASH if SPL_DM && SPL_SPI
	select SPL_OF_CONTROL if SPL_DM
	select SPL_PINCONF if SPL_DM
	select SPL_PINCTRL if SPL_DM
	select SPL_RAM if SPL_DM
	select SPL_SEPARATE_BSS if SPL
	select SUNXI_GPIO if GPIO
	select SUPPORT_SPL
	select SYS_NS16550 if SERIAL
	select USB if DISTRO_DEFAULTS
	select USB_KEYBOARD if DISTRO_DEFAULTS && USB_HOST
	select USB_STORAGE if DISTRO_DEFAULTS && USB_HOST
	select USE_PREBOOT
	imply CMD_DM
	imply CMD_GPT
	imply DISTRO_DEFAULTS
	imply DM_REGULATOR
	imply DM_REGULATOR_FIXED
	imply FAT_WRITE
	imply FIT
	imply MMC
	imply OF_LIBFDT_OVERLAY
	imply PRE_CONSOLE_BUFFER
	imply SPL
	imply SPL_GPIO
	imply SPL_LIBCOMMON_SUPPORT
	imply SPL_LIBGENERIC_SUPPORT
	imply SPL_LOAD_FIT
	imply SPL_MMC if MMC
	imply SPL_POWER
	imply SPL_SERIAL
	imply SYSRESET
	imply SYSRESET_SBI
	imply SYSRESET_WATCHDOG
	imply SYSRESET_WATCHDOG_AUTO
	imply USB_EHCI_GENERIC
	imply USB_EHCI_HCD
	imply USB_OHCI_GENERIC
	imply USB_OHCI_HCD
	imply WDT

endif
```

## board/sunxi/Kconfig
```kconfig
config BOARD_SUNXI
	bool
	select BINMAN
	select CMD_GPIO if GPIO
	select CMD_MMC if MMC
	select CMD_USB if DISTRO_DEFAULTS && USB_HOST
	select CLK
	select DM
	select DM_GPIO if GPIO
	select DM_I2C if I2C
	select DM_SPI if SPI
	select DM_SPI_FLASH if SPI && MTD
	select DM_KEYBOARD
	select DM_MMC if MMC
	select DM_SERIAL if SERIAL
	select OF_BOARD_SETUP
	select PINCTRL
	select SPL_SEPARATE_BSS if SPL
	select SUNXI_GPIO if GPIO
	select SYS_NS16550 if SERIAL
	select USB if DISTRO_DEFAULTS
	select USB_KEYBOARD if DISTRO_DEFAULTS && USB_HOST
	select USB_STORAGE if DISTRO_DEFAULTS && USB_HOST
	select USE_PREBOOT
	select ENV_RELOC_GD_ENV_ADDR
	imply BOARD_LATE_INIT
	imply CMD_DM
	imply CMD_GPT
	imply CMD_UBI if MTD_RAW_NAND
	imply DISTRO_DEFAULTS
	imply DM_REGULATOR
	imply DM_REGULATOR_FIXED
	imply FAT_WRITE
	imply FIT
	imply OF_LIBFDT_OVERLAY
	imply PRE_CONSOLE_BUFFER
	imply SPL_GPIO
	imply SPL_LIBCOMMON_SUPPORT
	imply SPL_LIBGENERIC_SUPPORT
	imply SPL_LOAD_FIT
	imply SPL_MMC if MMC
	imply SPL_POWER
	imply SPL_SERIAL
	imply SYS_I2C_MVTWSI
	imply SYSRESET
	imply SYSRESET_WATCHDOG
	imply SYSRESET_WATCHDOG_AUTO
	imply USB_EHCI_GENERIC
	imply USB_EHCI_HCD
	imply USB_GADGET
	imply USB_OHCI_GENERIC
	imply USB_OHCI_HCD
	imply WDT

if BOARD_SUNXI

config IDENT_STRING
	default " Allwinner Technology"

config SUNXI_SRAM_ADDRESS
	hex
	default 0x10000 if MACH_SUN9I || MACH_SUN50I || MACH_SUN50I_H5
	default 0x44000 if MACH_SUN55I_A523
	default 0x20000 if SUN50I_GEN_H6 || SUNXI_GEN_NCAT2
	default 0x0
	---help---
	Older Allwinner SoCs have their mask boot ROM mapped just below 4GB,
	with the first SRAM region being located at address 0.
	Some newer SoCs map the boot ROM at address 0 instead and move the
	SRAM to a different address.

config SYS_CLK_FREQ
	default 408000000 if MACH_SUNIV
	default 792000000 if MACH_SUN55I_A523
	default 1008000000 if MACH_SUN4I
	default 1008000000 if MACH_SUN5I
	default 1008000000 if MACH_SUN6I
	default 912000000 if MACH_SUN7I
	default 816000000 if MACH_SUN50I || MACH_SUN50I_H5
	default 1008000000 if MACH_SUN8I
	default 1008000000 if MACH_SUN9I
	default 888000000 if MACH_SUN50I_H6
	default 1008000000 if MACH_SUN50I_H616
	default 1008000000 if MACH_SUN8I_R528

config SYS_CONFIG_NAME
	default "suniv" if MACH_SUNIV
	default "sun4i" if MACH_SUN4I
	default "sun5i" if MACH_SUN5I
	default "sun6i" if MACH_SUN6I
	default "sun7i" if MACH_SUN7I
	default "sun8i" if MACH_SUN8I
	default "sun8i" if MACH_SUN8I_R528
	default "sun9i" if MACH_SUN9I
	default "sun50i" if MACH_SUN50I
	default "sun50i" if MACH_SUN50I_H6
	default "sun50i" if MACH_SUN50I_H616
	default "sun50i" if MACH_SUN50I_A133
	default "sun55i" if MACH_SUN55I_A523

config SYS_BOARD
	default "sunxi"

config SYS_SOC
	default "sunxi"

config SPL_TEXT_BASE
	default 0x10060 if MACH_SUN9I || MACH_SUN50I || MACH_SUN50I_H5
	default 0x44060 if MACH_SUN55I_A523
	default 0x20060 if SUN50I_GEN_H6 || SUNXI_GEN_NCAT2
	default 0x00060

config SUNXI_MINIMUM_DRAM_MB
	int
	default 32 if MACH_SUNIV
	default 64 if MACH_SUN8I_V3S
	default 256
	---help---
	Minimum DRAM size expected on the board. Traditionally we assumed
	256 MB, so that U-Boot would load at 160MB. With co-packaged DRAM
	we have smaller sizes, though, so that U-Boot's own load address and
	the default payload addresses must be shifted down.
	This is expected to be fixed by the SoC selection.

config PRE_CON_BUF_ADDR
	default 0x81000000 if MACH_SUNIV
	default 0x2f000000 if MACH_SUN9I
	default 0x4f000000 if SUNXI_MINIMUM_DRAM_MB >= 256
	default 0x43000000 if SUNXI_MINIMUM_DRAM_MB >= 64

config SPL_BSS_START_ADDR
	default 0x81f80000 if MACH_SUNIV
	default 0x2ff80000 if MACH_SUN9I
	default 0x4ff80000 if SUNXI_MINIMUM_DRAM_MB >= 256
	default 0x43f80000 if SUNXI_MINIMUM_DRAM_MB >= 64

config SPL_STACK_R_ADDR
	default 0x81e00000 if MACH_SUNIV
	default 0x2fe00000 if MACH_SUN9I
	default 0x4fe00000 if SUNXI_MINIMUM_DRAM_MB >= 256
	default 0x43e00000 if SUNXI_MINIMUM_DRAM_MB >= 64

menu "sunxi board options"

choice
	prompt "SPL Image Type"
	depends on SPL
	default SPL_IMAGE_TYPE_SUNXI_EGON

config SPL_IMAGE_TYPE_SUNXI_EGON
	bool "eGON (normal)"
	help
	  Select this option to embed the SPL binary in an eGON.BT0 image,
	  which is compatible with the normal boot ROM (NBROM).

	  This is usually the correct option to choose.

config SPL_IMAGE_TYPE_SUNXI_TOC0
	bool "TOC0 (secure)"
	help
	  Select this option to embed the SPL binary in a TOC0 image,
	  which is compatible with the secure boot ROM (SBROM).

endchoice

config SPL_IMAGE_TYPE
	string
	default "sunxi_egon" if SPL_IMAGE_TYPE_SUNXI_EGON
	default "sunxi_toc0" if SPL_IMAGE_TYPE_SUNXI_TOC0

endmenu

endif
```

## configs/lichee_rv_dock_defconfig
```kconfig
CONFIG_RISCV=y
CONFIG_DEFAULT_DEVICE_TREE="allwinner/sun20i-d1-lichee-rv-dock"
CONFIG_DRAM_SUNXI_ODT_EN=0x1
CONFIG_DRAM_SUNXI_TPR0=0x004a2195
CONFIG_DRAM_SUNXI_TPR11=0x00870000
CONFIG_DRAM_SUNXI_TPR12=0x00000024
CONFIG_DRAM_SUNXI_TPR13=0x34050100
CONFIG_TARGET_SUN20I_D1=y
CONFIG_ARCH_RV64I=y
CONFIG_RISCV_SMODE=y
# CONFIG_SPL_SMP is not set
CONFIG_SPL_SYS_MALLOC=y
CONFIG_SPL_OPENSBI_SCRATCH_OPTIONS=0x0
CONFIG_DRAM_SUN20I_D1=y
```

## configs/mangopi_mq_r_defconfig
```kconfig
CONFIG_ARM=y
CONFIG_ARCH_SUNXI=y
CONFIG_DEFAULT_DEVICE_TREE="allwinner/sun8i-t113s-mangopi-mq-r-t113"
CONFIG_SPL=y
CONFIG_MACH_SUN8I_R528=y
CONFIG_SUNXI_MINIMUM_DRAM_MB=128
# CONFIG_SYS_MALLOC_CLEAR_ON_INIT is not set
CONFIG_CONS_INDEX=4
```

## configs/mangopi_mq_riscv_defconfig
```kconfig
CONFIG_RISCV=y
CONFIG_HAS_CUSTOM_SYS_INIT_SP_ADDR=y
CONFIG_CUSTOM_SYS_INIT_SP_ADDR=0x43e00000
CONFIG_DEFAULT_DEVICE_TREE="sun20i-d1s-mangopi-mq"
CONFIG_TARGET_SUN20I_D1=y
CONFIG_ARCH_RV64I=y
CONFIG_RISCV_SMODE=y
# CONFIG_SPL_SMP is not set
CONFIG_SPL_SYS_MALLOC=y
CONFIG_SPL_OPENSBI_SCRATCH_OPTIONS=0x0
# CONFIG_SYS_I2C_MVTWSI is not set
CONFIG_DRAM_SUN20I_D1=y
CONFIG_DRAM_SUNXI_ODT_EN=0
CONFIG_DRAM_SUNXI_TPR0=0x00471992
CONFIG_DRAM_SUNXI_TPR11=0x00030010
CONFIG_DRAM_SUNXI_TPR12=0x00000035
CONFIG_DRAM_SUNXI_TPR13=0x34000000
CONFIG_SUNXI_MINIMUM_DRAM_MB=64
```
