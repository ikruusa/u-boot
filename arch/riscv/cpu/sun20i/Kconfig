## arch/riscv/cpu/sun20i/Kconfig
```kconfig
# SPDX-License-Identifier: GPL-2.0+

config SUN20I
	bool
	select SYS_CACHE_SHIFT_6
	select SYS_CACHE_THEAD_CMO if !SYS_DCACHE_OFF

config SUNXI_GEN_NCAT2
	bool
	default y if SUN20I
	select DRAM_SUN20I_D1
	select MMC_SUNXI_HAS_NEW_MODE
	select SUPPORT_SPL
	help
	  The D1/D1s(F133) SoCs belong to the same ("NCAT2") peripheral
	  generation as the R528/T113. Declare this symbol here, so the
	  sunxi code can take its NCAT2 paths.
```

## configs/mangopi_mq_d1s_defconfig
```kconfig
CONFIG_RISCV=y
CONFIG_DEFAULT_DEVICE_TREE="allwinner/sun20i-d1s-mangopi-mq"
CONFIG_SUNXI_DRAM_TYPE_DDR2=y
CONFIG_DRAM_ZQ=8092665
CONFIG_DRAM_CLK=528
CONFIG_DRAM_SUNXI_ODT_EN=0x0
CONFIG_DRAM_SUNXI_MR1=0x02
CONFIG_DRAM_SUNXI_TPR0=0x00471992
CONFIG_DRAM_SUNXI_TPR11=0x00030010
CONFIG_DRAM_SUNXI_TPR12=0x00000035
CONFIG_DRAM_SUNXI_TPR13=0x34004002
CONFIG_TARGET_SUN20I=y
CONFIG_ARCH_RV64I=y
CONFIG_RISCV_SMODE=y
# CONFIG_SPL_SMP is not set
CONFIG_SPL_SYS_MALLOC=y
CONFIG_SPL_OPENSBI_SCRATCH_OPTIONS=0x0
CONFIG_IDENT_STRING=" Allwinner D1s/F133-A"
CONFIG_CONS_INDEX=4
CONFIG_NS16550_CLK_ENABLE=y
```
